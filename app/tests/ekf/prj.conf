## CMakeLists.txt
```
cmake_minimum_required(VERSION 3.20.0)

find_package(Zephyr REQUIRED HINTS $ENV{ZEPHYR_BASE})
project(ekf_tests LANGUAGES C)

set(APP_ROOT ${CMAKE_CURRENT_LIST_DIR}/../..)

target_sources(app PRIVATE
	src/test_ekf_math.c
	src/test_ekf_core.c
	src/sim.c
	${APP_ROOT}/src/ekf/ekf_math.c
	${APP_ROOT}/src/ekf/ekf_core.c
)
target_include_directories(app PRIVATE ${APP_ROOT}/src/ekf)
target_compile_options(app PRIVATE
	-Wall -Wextra -Wshadow -Wdouble-promotion -Wfloat-conversion -Werror)
```

## prj.conf
```kconfig
CONFIG_ZTEST=y
CONFIG_FPU=y
CONFIG_CMSIS_DSP=y
CONFIG_CMSIS_DSP_MATRIX=y
CONFIG_CMSIS_DSP_MATRIXCHECK=y
CONFIG_ZTEST_STACK_SIZE=4096
```

## src/sim.c
```c
#include "sim.h"

#include <math.h>
#include <stddef.h>

#define SIM_GYRO_NOISE  6.3e-4f
#define SIM_ACCEL_NOISE 4.2e-3f
#define SIM_MAG_NOISE   2.0e-3f
#define SIM_G0          9.80665f

const float sim_true_bias[3] = { 0.01f, -0.02f, 0.015f };

const float sim_field_n[3] = { 0.25f, 0.0f, 0.40f };

static uint32_t xorshift32(uint32_t *s)
{
	*s ^= *s << 13;
	*s ^= *s >> 17;
	*s ^= *s << 5;
	return *s;
}

float sim_uniform(uint32_t *seed)
{
	return (float)(xorshift32(seed) >> 8) * (1.0f / 16777216.0f);
}

float sim_randn(uint32_t *seed)
{
	float acc = 0.0f;

	for (int i = 0; i < 12; i++) {
		acc += sim_uniform(seed);
	}

	return acc - 6.0f;
}

void sim_rotation_matrix(const float euler[3], float rot[3][3])
{
	float sr = sinf(euler[0]), cr = cosf(euler[0]);
	float sp = sinf(euler[1]), cp = cosf(euler[1]);
	float sy = sinf(euler[2]), cy = cosf(euler[2]);

	/* R = Rz(yaw) Ry(pitch) Rx(roll), body to navigation. */
	rot[0][0] = cy * cp;
	rot[0][1] = cy * sp * sr - sy * cr;
	rot[0][2] = cy * sp * cr + sy * sr;
	rot[1][0] = sy * cp;
	rot[1][1] = sy * sp * sr + cy * cr;
	rot[1][2] = sy * sp * cr - cy * sr;
	rot[2][0] = -sp;
	rot[2][1] = cp * sr;
	rot[2][2] = cp * cr;
}

float sim_wrap_deg(float angle_deg)
{
	while (angle_deg > 180.0f) {
		angle_deg -= 360.0f;
	}
	while (angle_deg <= -180.0f) {
		angle_deg += 360.0f;
	}

	return angle_deg;
}

void sim_init(struct sim *sim, sim_motion_fn motion, sim_disturbance_fn disturbance)
{
	sim->motion = motion;
	sim->disturbance = disturbance;
	sim->gyro_limit = 0.0f;
	sim->seed = 0x12345678U;
	sim->step = 0;
}

static void body_rate(const float euler[3], const float euler_rate[3], float rate_b[3])
{
	float sr = sinf(euler[0]), cr = cosf(euler[0]);
	float sp = sinf(euler[1]), cp = cosf(euler[1]);

	rate_b[0] = euler_rate[0] - euler_rate[2] * sp;
	rate_b[1] = euler_rate[1] * cr + euler_rate[2] * sr * cp;
	rate_b[2] = -euler_rate[1] * sr + euler_rate[2] * cr * cp;
}

void sim_next(struct sim *sim, struct sim_sample *sample)
{
	float rot[3][3], mid_euler[3], mid_rate[3], unused[3], rate_b[3];

	sim->step++;
	sample->t = (float)sim->step * SIM_DT_S;

	/* The gyro integrates over the past interval; sample the rate at its midpoint. */
	sim->motion(sample->t - 0.5f * SIM_DT_S, mid_euler, mid_rate);
	body_rate(mid_euler, mid_rate, rate_b);

	sim->motion(sample->t, sample->euler, unused);
	sim_rotation_matrix(sample->euler, rot);

	for (int i = 0; i < 3; i++) {
		sample->accel[i] = -SIM_G0 * rot[2][i];
		sample->mag[i] = rot[0][i] * sim_field_n[0] + rot[1][i] * sim_field_n[1] +
				 rot[2][i] * sim_field_n[2];
	}
	if (sim->disturbance != NULL) {
		sim->disturbance(sample->t, sample->accel, sample->mag);
	}

	for (int i = 0; i < 3; i++) {
		float gyro = rate_b[i] + sim_true_bias[i] + SIM_GYRO_NOISE * sim_randn(&sim->seed);

		if (sim->gyro_limit > 0.0f) {
			gyro = fminf(sim->gyro_limit, fmaxf(-sim->gyro_limit, gyro));
		}
		sample->gyro[i] = gyro;
		sample->accel[i] += SIM_ACCEL_NOISE * sim_randn(&sim->seed);
		sample->mag[i] += SIM_MAG_NOISE * sim_randn(&sim->seed);
	}
}
```

## src/sim.h
```c
/*
 * Synthetic IMU for the filter tests (TEST_PLAN.md section 3.1).
 *
 * Ground truth is built from Euler angles with formulas written here, never
 * with ekf_math.c, so that a sign error in the filter cannot cancel itself out.
 */
#ifndef SIM_H_
#define SIM_H_

#include <stdint.h>

#define SIM_DT_S       (1.0f / 104.0f)
#define SIM_DEG        0.017453292519943f
#define SIM_FIELD_NORM 0.4717f
#define SIM_FIELD_DIP  (57.99f * SIM_DEG)

/* Fills roll/pitch/yaw [rad] and their time derivatives [rad/s] at time t. */
typedef void (*sim_motion_fn)(float t, float euler[3], float euler_rate[3]);

/* Adds disturbances to the ideal body-frame readings at time t. */
typedef void (*sim_disturbance_fn)(float t, float accel_b[3], float mag_b[3]);

struct sim {
	sim_motion_fn motion;
	sim_disturbance_fn disturbance; /* may be NULL */
	float gyro_limit;               /* clip level in rad/s; 0 disables clipping */
	uint32_t seed;
	uint32_t step;
};

struct sim_sample {
	float t;
	float euler[3]; /* true roll, pitch, yaw */
	float gyro[3];
	float accel[3];
	float mag[3];
};

extern const float sim_true_bias[3];
extern const float sim_field_n[3]; /* gauss, NED */

void sim_init(struct sim *sim, sim_motion_fn motion, sim_disturbance_fn disturbance);
void sim_next(struct sim *sim, struct sim_sample *sample);

float sim_uniform(uint32_t *seed);
float sim_randn(uint32_t *seed);

void sim_rotation_matrix(const float euler[3], float rot[3][3]);
float sim_wrap_deg(float angle_deg);

#endif /* SIM_H_ */
```

## src/test_ekf_core.c
```c
/* TEST_PLAN.md section 3.3, T-EKF-01..13, plus the gate paths of MATH_SPEC.md 8 and 9. */
#include <errno.h>
#include <math.h>
#include <string.h>

#include <zephyr/ztest.h>

#include "ekf_config.h"
#include "ekf_core.h"
#include "ekf_math.h"
#include "sim.h"

#define N            EKF_STATE_DIM
#define RAD_TO_DEG   (1.0f / SIM_DEG)
#define STEPS_PER_S  104
#define TWO_PI       (2.0f * EKF_PI)
#define ROLL_START_S 10.0f
#define ROLL_TIME_S  0.35f

static const struct ekf_params params = {
	.declination_rad = 0.0f,
	.inclination_rad = SIM_FIELD_DIP,
	.field_norm_g = SIM_FIELD_NORM,
	.use_mag = true,
};

static const float v1_q[4] = { 0.8616424f, 0.2996729f, -0.0574224f, 0.4055504f };
static const float zero_bias[3] = { 0.0f, 0.0f, 0.0f };

static struct ekf ekf;
static struct sim sim;

/* Attitude held by motion_static(), rad. */
static float pose[3];

static void set_pose_deg(float roll_deg, float pitch_deg, float yaw_deg)
{
	pose[0] = roll_deg * SIM_DEG;
	pose[1] = pitch_deg * SIM_DEG;
	pose[2] = yaw_deg * SIM_DEG;
}

static void motion_static(float t, float euler[3], float euler_rate[3])
{
	ARG_UNUSED(t);

	for (int i = 0; i < 3; i++) {
		euler[i] = pose[i];
		euler_rate[i] = 0.0f;
	}
}

static void motion_dynamic(float t, float euler[3], float euler_rate[3])
{
	const float roll_w = TWO_PI * 0.2f, pitch_w = TWO_PI * 0.13f;
	const float roll_amp = 20.0f * SIM_DEG, pitch_amp = 15.0f * SIM_DEG;
	const float yaw_rate = 30.0f * SIM_DEG;

	euler[0] = roll_amp * sinf(roll_w * t);
	euler[1] = pitch_amp * sinf(pitch_w * t);
	euler[2] = yaw_rate * t;
	euler_rate[0] = roll_amp * roll_w * cosf(roll_w * t);
	euler_rate[1] = pitch_amp * pitch_w * cosf(pitch_w * t);
	euler_rate[2] = yaw_rate;
}

/* One full roll at 1028 dps on top of the static pose. */
static void motion_fast_roll(float t, float euler[3], float euler_rate[3])
{
	const float rate = TWO_PI / ROLL_TIME_S;

	motion_static(t, euler, euler_rate);
	if (t >= ROLL_START_S && t < ROLL_START_S + ROLL_TIME_S) {
		euler[0] += rate * (t - ROLL_START_S);
		euler_rate[0] = rate;
	}
}

static void disturb_accel_step(float t, float accel_b[3], float mag_b[3])
{
	ARG_UNUSED(mag_b);

	if (t >= 10.0f && t < 12.0f) {
		accel_b[0] += 0.5f * EKF_G0;
	}
}

static void disturb_accel_shake(float t, float accel_b[3], float mag_b[3])
{
	ARG_UNUSED(mag_b);

	if (t >= 10.0f && t < 15.0f) {
		accel_b[0] += 0.3f * EKF_G0 * sinf(TWO_PI * 1.0f * t);
		accel_b[1] += 0.2f * EKF_G0 * cosf(TWO_PI * 0.7f * t);
	}
}

static void disturb_mag_pulse(float t, float accel_b[3], float mag_b[3])
{
	ARG_UNUSED(accel_b);

	if (t >= 10.0f && t < 15.0f) {
		mag_b[0] += 0.3f;
	}
}

static void disturb_mag_permanent(float t, float accel_b[3], float mag_b[3])
{
	ARG_UNUSED(accel_b);

	if (t >= 10.0f) {
		mag_b[0] += 0.3f;
	}
}

static bool applied_or_gated(int rc)
{
	return rc == 0 || rc == -EAGAIN;
}

static void filter_step(const struct sim_sample *sample)
{
	zassert_ok(ekf_predict(&ekf, sample->gyro, SIM_DT_S));
	zassert_true(applied_or_gated(ekf_update_accel(&ekf, sample->accel)));
	zassert_true(applied_or_gated(ekf_update_mag(&ekf, sample->mag)));
}

/* Estimate minus truth for roll, pitch and yaw, each wrapped, in degrees. */
static void attitude_error_deg(const struct sim_sample *sample, float error_deg[3])
{
	float estimate[3];

	quat_to_euler(ekf.x, &estimate[0], &estimate[1], &estimate[2]);
	for (int i = 0; i < 3; i++) {
		error_deg[i] = sim_wrap_deg((estimate[i] - sample->euler[i]) * RAD_TO_DEG);
	}
}

static int to_mdeg(float angle_deg)
{
	return (int)(angle_deg * 1000.0f);
}

/* Averages one alignment window the way the fusion thread does. */
static void average_window(float accel_mean[3], float mag_mean[3], float gyro_mean[3])
{
	struct sim_sample sample;

	memset(accel_mean, 0, 3 * sizeof(float));
	memset(mag_mean, 0, 3 * sizeof(float));
	memset(gyro_mean, 0, 3 * sizeof(float));

	for (uint32_t n = 0; n < EKF_ALIGN_SAMPLES; n++) {
		sim_next(&sim, &sample);
		for (int i = 0; i < 3; i++) {
			accel_mean[i] += sample.accel[i] / (float)EKF_ALIGN_SAMPLES;
			mag_mean[i] += sample.mag[i] / (float)EKF_ALIGN_SAMPLES;
			gyro_mean[i] += sample.gyro[i] / (float)EKF_ALIGN_SAMPLES;
		}
	}
}

static void start_from_stationary_alignment(void)
{
	float accel_mean[3], mag_mean[3], gyro_mean[3], q[4];

	average_window(accel_mean, mag_mean, gyro_mean);
	zassert_ok(ekf_align(accel_mean, mag_mean, true, params.declination_rad, q));
	zassert_ok(ekf_init(&ekf, &params, q, gyro_mean, true));
}

/* Runs the simulation up to end_s and tracks the largest error seen from track_from_s on. */
static void run_and_track(float track_from_s, float end_s, float max_error_deg[3])
{
	struct sim_sample sample;
	float error_deg[3];

	memset(max_error_deg, 0, 3 * sizeof(float));

	do {
		sim_next(&sim, &sample);
		filter_step(&sample);
		if (sample.t < track_from_s) {
			continue;
		}

		attitude_error_deg(&sample, error_deg);
		for (int i = 0; i < 3; i++) {
			max_error_deg[i] = fmaxf(max_error_deg[i], fabsf(error_deg[i]));
		}
	} while (sample.t < end_s);
}

static void reset_fixture(void *fixture)
{
	ARG_UNUSED(fixture);

	memset(&ekf, 0, sizeof(ekf));
	set_pose_deg(0.0f, 0.0f, 0.0f);
	sim_init(&sim, motion_static, NULL);
}

ZTEST(ekf_core, test_init_projects_covariance_onto_tangent_space)
{
	const float quat_variance = EKF_P0_QUAT_SIGMA * EKF_P0_QUAT_SIGMA;
	const float bias_variance = EKF_P0_BIAS_SIGMA_STATIC * EKF_P0_BIAS_SIGMA_STATIC;
	float trace = 0.0f;

	zassert_ok(ekf_init(&ekf, &params, v1_q, zero_bias, true));
	zassert_equal(ekf.state, EKF_STATE_RUNNING);

	for (int row = 0; row < 4; row++) {
		float along_q = 0.0f;

		trace += ekf.P[row * N + row];
		for (int col = 0; col < 4; col++) {
			along_q += ekf.P[row * N + col] * ekf.x[col];
		}
		zassert_within(along_q, 0.0f, 1e-8f, "P_qq q row %d", row);
	}
	zassert_within(trace, 3.0f * quat_variance, 3.0f * quat_variance * 1e-5f);

	for (int i = 4; i < N; i++) {
		zassert_within(ekf.P[i * N + i], bias_variance, bias_variance * 1e-5f);
	}
}

ZTEST(ekf_core, test_align_recovers_reference_attitude)
{
	const float v3_accel[3] = { -3.3540718f, -4.6076183f, -7.9806290f };
	const float v4_mag[3] = { 0.3029238f, 0.0046148f, 0.3615465f };
	float q[4], roll, pitch, yaw;

	zassert_ok(ekf_align(v3_accel, v4_mag, true, 0.0f, q));
	quat_to_euler(q, &roll, &pitch, &yaw);
	zassert_within(roll, 30.0f * SIM_DEG, 1e-4f);
	zassert_within(pitch, -20.0f * SIM_DEG, 1e-4f);
	zassert_within(yaw, 45.0f * SIM_DEG, 1e-4f);

	zassert_ok(ekf_align(v3_accel, v4_mag, false, 0.0f, q));
	quat_to_euler(q, &roll, &pitch, &yaw);
	zassert_within(roll, 30.0f * SIM_DEG, 1e-4f);
	zassert_within(pitch, -20.0f * SIM_DEG, 1e-4f);
	zassert_within(yaw, 0.0f, 1e-4f);
}

ZTEST(ekf_core, test_predict_integrates_constant_yaw_rate)
{
	const float identity[4] = { 1.0f, 0.0f, 0.0f, 0.0f };
	const float gyro[3] = { 0.0f, 0.0f, 0.5f };
	float roll, pitch, yaw;

	zassert_ok(ekf_init(&ekf, &params, identity, zero_bias, true));
	for (int step = 0; step < 208; step++) {
		zassert_ok(ekf_predict(&ekf, gyro, SIM_DT_S));
	}

	quat_to_euler(ekf.x, &roll, &pitch, &yaw);
	zassert_within(yaw, 1.0f, 1e-4f);
}

static void assert_predict_invariants(int step)
{
	const float *q = ekf.x;
	float q_norm = sqrtf(q[0] * q[0] + q[1] * q[1] + q[2] * q[2] + q[3] * q[3]);
	float max_abs = 0.0f, max_asymmetry = 0.0f, pqq_norm_sq = 0.0f, along_q_sq = 0.0f;

	zassert_within(q_norm, 1.0f, 1e-6f, "step %d", step);

	for (int row = 0; row < N; row++) {
		zassert_true(ekf.P[row * N + row] >= 0.0f, "step %d", step);
		for (int col = 0; col < N; col++) {
			float element = ekf.P[row * N + col];

			max_abs = fmaxf(max_abs, fabsf(element));
			max_asymmetry = fmaxf(max_asymmetry, fabsf(element - ekf.P[col * N + row]));
		}
	}
	zassert_true(max_asymmetry <= 1e-6f * max_abs, "step %d", step);

	for (int row = 0; row < 4; row++) {
		float along_q = 0.0f;

		for (int col = 0; col < 4; col++) {
			along_q += ekf.P[row * N + col] * q[col];
			pqq_norm_sq += ekf.P[row * N + col] * ekf.P[row * N + col];
		}
		along_q_sq += along_q * along_q;
	}
	zassert_true(sqrtf(along_q_sq) < 1e-6f * sqrtf(pqq_norm_sq), "step %d", step);
}

ZTEST(ekf_core, test_predict_keeps_quaternion_and_covariance_invariants)
{
	/* Each component below 5/sqrt(3) keeps the rate norm below 5 rad/s. */
	const float component_limit = 5.0f / sqrtf(3.0f);
	uint32_t seed = 0x12345678U;

	zassert_ok(ekf_init(&ekf, &params, v1_q, zero_bias, false));

	for (int step = 0; step < 10000; step++) {
		float gyro[3];

		for (int i = 0; i < 3; i++) {
			gyro[i] = component_limit * (2.0f * sim_uniform(&seed) - 1.0f);
		}
		zassert_ok(ekf_predict(&ekf, gyro, SIM_DT_S));
		assert_predict_invariants(step);
	}
}

ZTEST(ekf_core, test_invalid_input_is_rejected_without_touching_state)
{
	const float gyro[3] = { 0.1f, 0.2f, 0.3f };
	const float nan_gyro[3] = { 0.1f, NAN, 0.3f };
	const float tiny_accel[3] = { 5e-4f, 0.0f, 0.0f };
	const float tiny_mag[3] = { 0.0f, 5e-7f, 0.0f };
	const float nan_vector[3] = { NAN, 0.0f, 1.0f };
	static struct ekf before;

	zassert_ok(ekf_init(&ekf, &params, v1_q, zero_bias, true));
	memcpy(&before, &ekf, sizeof(ekf));

	zassert_equal(ekf_predict(&ekf, nan_gyro, SIM_DT_S), -EINVAL);
	zassert_equal(ekf_predict(&ekf, gyro, 0.0f), -EINVAL);
	zassert_equal(ekf_predict(&ekf, gyro, 0.06f), -EINVAL);
	zassert_equal(ekf_predict(&ekf, gyro, NAN), -EINVAL);
	zassert_equal(ekf_update_accel(&ekf, tiny_accel), -EINVAL);
	zassert_equal(ekf_update_accel(&ekf, nan_vector), -EINVAL);
	zassert_equal(ekf_update_mag(&ekf, tiny_mag), -EINVAL);
	zassert_equal(ekf_update_mag(&ekf, nan_vector), -EINVAL);

	zassert_mem_equal(&before, &ekf, sizeof(ekf));
}

ZTEST(ekf_core, test_static_run_converges_attitude_and_bias)
{
	float q[4], max_error_deg[3];

	set_pose_deg(10.0f, -5.0f, 120.0f);
	quat_from_euler(pose[0], pose[1], pose[2], q);
	zassert_ok(ekf_init(&ekf, &params, q, zero_bias, false));

	run_and_track(30.0f, 30.0f, max_error_deg);

	zassert_true(max_error_deg[0] < 0.1f, "roll %d mdeg", to_mdeg(max_error_deg[0]));
	zassert_true(max_error_deg[1] < 0.1f, "pitch %d mdeg", to_mdeg(max_error_deg[1]));
	zassert_true(max_error_deg[2] < 0.3f, "yaw %d mdeg", to_mdeg(max_error_deg[2]));

	for (int i = 0; i < 3; i++) {
		float bias_error = fabsf(ekf.x[4 + i] - sim_true_bias[i]);

		zassert_true(bias_error < 5e-4f, "bias %d error %d urad/s", i,
			     (int)(bias_error * 1e6f));
		zassert_true(ekf.P[(4 + i) * N + 4 + i] < 1e-6f, "bias %d variance", i);
	}
}

ZTEST(ekf_core, test_dynamic_motion_is_tracked)
{
	const float settle_s = 5.0f, end_s = 30.0f;
	float sum_sq[3] = { 0.0f, 0.0f, 0.0f }, max_error_deg[3] = { 0.0f, 0.0f, 0.0f };
	uint32_t tracked = 0, total = 0;
	struct sim_sample sample;
	struct ekf_stats stats;
	float q[4];

	/* Alignment from the first sample: the board is already moving. */
	sim_init(&sim, motion_dynamic, NULL);
	sim_next(&sim, &sample);
	zassert_ok(ekf_align(sample.accel, sample.mag, true, params.declination_rad, q));
	zassert_ok(ekf_init(&ekf, &params, q, zero_bias, false));

	while (sample.t < end_s) {
		float error_deg[3];

		sim_next(&sim, &sample);
		filter_step(&sample);
		total++;
		if (sample.t < settle_s) {
			continue;
		}

		attitude_error_deg(&sample, error_deg);
		tracked++;
		for (int i = 0; i < 3; i++) {
			sum_sq[i] += error_deg[i] * error_deg[i];
			max_error_deg[i] = fmaxf(max_error_deg[i], fabsf(error_deg[i]));
		}
	}

	for (int i = 0; i < 3; i++) {
		float rms = sqrtf(sum_sq[i] / (float)tracked);

		zassert_true(rms < 0.5f, "axis %d rms %d mdeg", i, to_mdeg(rms));
		zassert_true(max_error_deg[i] < 1.5f, "axis %d max %d mdeg", i,
			     to_mdeg(max_error_deg[i]));
	}

	ekf_get_stats(&ekf, &stats);
	zassert_true((stats.acc_rejected + stats.mag_rejected) * 100U < total, "rejected %u + %u",
		     stats.acc_rejected, stats.mag_rejected);
}

ZTEST(ekf_core, test_constant_linear_acceleration_is_rejected)
{
	float max_error_deg[3];
	struct ekf_stats stats;

	set_pose_deg(10.0f, -5.0f, 120.0f);
	sim_init(&sim, motion_static, disturb_accel_step);
	start_from_stationary_alignment();

	run_and_track(10.0f, 20.0f, max_error_deg);

	ekf_get_stats(&ekf, &stats);
	zassert_true(max_error_deg[0] < 0.5f, "roll %d mdeg", to_mdeg(max_error_deg[0]));
	zassert_true(max_error_deg[1] < 0.5f, "pitch %d mdeg", to_mdeg(max_error_deg[1]));
	zassert_equal(stats.tilt_resets, 0);
	zassert_true(stats.acc_rejected + stats.acc_gated > 0);
}

ZTEST(ekf_core, test_shaking_acceleration_stays_bounded)
{
	float max_error_deg[3];

	set_pose_deg(10.0f, -5.0f, 120.0f);
	sim_init(&sim, motion_static, disturb_accel_shake);
	start_from_stationary_alignment();

	run_and_track(10.0f, 20.0f, max_error_deg);

	zassert_true(max_error_deg[0] < 3.0f, "roll %d mdeg", to_mdeg(max_error_deg[0]));
	zassert_true(max_error_deg[1] < 3.0f, "pitch %d mdeg", to_mdeg(max_error_deg[1]));
}

ZTEST(ekf_core, test_short_magnetic_disturbance_is_ignored)
{
	float max_error_deg[3];
	struct ekf_stats stats;

	/* At this heading the disturbed field keeps its norm and dip, so only the NIS gate sees it. */
	set_pose_deg(10.0f, -5.0f, 120.0f);
	sim_init(&sim, motion_static, disturb_mag_pulse);
	start_from_stationary_alignment();

	run_and_track(10.0f, 20.0f, max_error_deg);

	ekf_get_stats(&ekf, &stats);
	zassert_true(max_error_deg[2] < 1.0f, "yaw %d mdeg", to_mdeg(max_error_deg[2]));
	zassert_equal(stats.yaw_resets, 0);
	zassert_true(stats.mag_rejected > 0, "the disturbance never reached the NIS gate");
}

ZTEST(ekf_core, test_permanent_magnetic_disturbance_is_adopted_after_distrust_period)
{
	struct sim_sample sample;
	float reset_time_s = 0.0f;

	set_pose_deg(10.0f, -5.0f, 120.0f);
	sim_init(&sim, motion_static, disturb_mag_permanent);
	start_from_stationary_alignment();

	do {
		uint32_t resets_before = ekf.stats.yaw_resets;

		sim_next(&sim, &sample);
		filter_step(&sample);
		if (ekf.stats.yaw_resets != resets_before) {
			reset_time_s = sample.t;
		}
	} while (sample.t < 60.0f);

	zassert_equal(ekf.stats.yaw_resets, 1, "yaw resets %u", ekf.stats.yaw_resets);
	zassert_true(reset_time_s >= 39.0f && reset_time_s <= 42.0f, "reset at %d ms",
		     (int)(reset_time_s * 1000.0f));
}

ZTEST(ekf_core, test_wrong_initial_heading_is_recovered_by_yaw_reset)
{
	float accel_mean[3], mag_mean[3], gyro_mean[3], q[4], error_deg[3];
	struct sim_sample sample;
	float start_s;

	set_pose_deg(10.0f, -5.0f, 120.0f);
	average_window(accel_mean, mag_mean, gyro_mean);
	quat_from_euler(pose[0], pose[1], 0.0f, q);
	zassert_ok(ekf_init(&ekf, &params, q, gyro_mean, true));
	zassert_false(ekf.heading_converged);

	sim_next(&sim, &sample);
	start_s = sample.t;
	filter_step(&sample);

	while (sample.t < start_s + 5.0f) {
		sim_next(&sim, &sample);
		filter_step(&sample);
	}
	attitude_error_deg(&sample, error_deg);
	zassert_equal(ekf.stats.yaw_resets, 1, "yaw resets %u", ekf.stats.yaw_resets);
	zassert_true(fabsf(error_deg[2]) < 1.0f, "yaw %d mdeg", to_mdeg(error_deg[2]));

	while (sample.t < start_s + 10.0f) {
		sim_next(&sim, &sample);
		filter_step(&sample);
	}
	zassert_true(ekf.heading_converged);
	zassert_true(ekf.yaw_valid);
	zassert_equal(ekf.stats.yaw_resets, 1);
}

ZTEST(ekf_core, test_heading_update_leaks_little_into_tilt)
{
	const float truth[3] = { 20.0f * SIM_DEG, -15.0f * SIM_DEG, 50.0f * SIM_DEG };
	float rot[3][3], mag_b[3], q[4], before[3], after[3];

	sim_rotation_matrix(truth, rot);
	for (int i = 0; i < 3; i++) {
		mag_b[i] = rot[0][i] * sim_field_n[0] + rot[1][i] * sim_field_n[1] +
			   rot[2][i] * sim_field_n[2];
	}

	quat_from_euler(truth[0], truth[1], 49.0f * SIM_DEG, q);
	zassert_ok(ekf_init(&ekf, &params, q, zero_bias, true));
	quat_to_euler(ekf.x, &before[0], &before[1], &before[2]);

	zassert_ok(ekf_update_mag(&ekf, mag_b));
	quat_to_euler(ekf.x, &after[0], &after[1], &after[2]);

	zassert_true(fabsf(after[0] - before[0]) * RAD_TO_DEG < 0.25f, "roll moved %d mdeg",
		     to_mdeg((after[0] - before[0]) * RAD_TO_DEG));
	zassert_true(fabsf(after[1] - before[1]) * RAD_TO_DEG < 0.25f, "pitch moved %d mdeg",
		     to_mdeg((after[1] - before[1]) * RAD_TO_DEG));
	zassert_true(after[2] > before[2], "yaw moved away from the measurement");
}

ZTEST(ekf_core, test_gyro_saturation_recovers_after_fast_roll)
{
	const float check_from_s = ROLL_START_S + ROLL_TIME_S + 0.5f;
	float max_error_deg[3];
	struct ekf_stats stats;

	set_pose_deg(0.0f, 0.0f, 30.0f);
	sim_init(&sim, motion_fast_roll, NULL);
	sim.gyro_limit = 8.727f;
	start_from_stationary_alignment();

	run_and_track(check_from_s, check_from_s + 2.0f, max_error_deg);

	ekf_get_stats(&ekf, &stats);
	zassert_true(stats.gyro_sat > 0);
	for (int i = 0; i < 3; i++) {
		zassert_true(max_error_deg[i] < 2.0f, "axis %d error %d mdeg", i,
			     to_mdeg(max_error_deg[i]));
	}
}

ZTEST(ekf_core, test_corrupted_covariance_drops_filter_to_aligning)
{
	const float gyro[3] = { 0.0f, 0.0f, 0.0f };
	const float accel[3] = { 0.0f, 0.0f, -EKF_G0 };
	struct ekf_stats stats;

	zassert_ok(ekf_init(&ekf, &params, v1_q, zero_bias, true));
	ekf.P[0] = NAN;

	zassert_equal(ekf_predict(&ekf, gyro, SIM_DT_S), -EDOM);
	ekf_get_stats(&ekf, &stats);
	zassert_equal(stats.numeric_faults, 1);
	zassert_equal(ekf.state, EKF_STATE_ALIGNING);

	/* A filter waiting for alignment accepts no samples. */
	zassert_equal(ekf_predict(&ekf, gyro, SIM_DT_S), -EINVAL);
	zassert_equal(ekf_update_accel(&ekf, accel), -EINVAL);
}

ZTEST(ekf_core, test_accel_update_skipped_above_hard_gate)
{
	const float identity[4] = { 1.0f, 0.0f, 0.0f, 0.0f };
	const float heavy[3] = { 0.0f, 0.0f, -1.25f * EKF_G0 };
	const float soft[3] = { 0.0f, 0.0f, -1.10f * EKF_G0 };
	static struct ekf before;

	zassert_ok(ekf_init(&ekf, &params, identity, zero_bias, true));
	memcpy(&before, &ekf, sizeof(ekf));

	zassert_equal(ekf_update_accel(&ekf, heavy), -EAGAIN);
	zassert_equal(ekf.stats.acc_gated, 1);
	zassert_mem_equal(ekf.x, before.x, sizeof(ekf.x));
	zassert_mem_equal(ekf.P, before.P, sizeof(ekf.P));

	zassert_ok(ekf_update_accel(&ekf, soft));
	zassert_equal(ekf.stats.acc_soft, 1);
	zassert_equal(ekf.stats.acc_gated, 1);
}

ZTEST(ekf_core, test_persistent_accel_rejection_resets_tilt)
{
	const float gyro[3] = { 0.0f, 0.0f, 0.0f };
	const float level[3] = { 0.0f, 0.0f, -EKF_G0 };
	float q[4], roll, pitch, yaw;

	/* 40 degrees of roll error is far outside the innovation gate. */
	quat_from_euler(40.0f * SIM_DEG, 0.0f, 25.0f * SIM_DEG, q);
	zassert_ok(ekf_init(&ekf, &params, q, zero_bias, true));

	for (uint32_t n = 1; n < EKF_TILT_RESET_REJECTS; n++) {
		zassert_ok(ekf_predict(&ekf, gyro, SIM_DT_S));
		zassert_equal(ekf_update_accel(&ekf, level), -EAGAIN);
	}
	zassert_equal(ekf.stats.tilt_resets, 0);
	zassert_equal(ekf.stats.acc_rejected, EKF_TILT_RESET_REJECTS - 1U);

	zassert_ok(ekf_predict(&ekf, gyro, SIM_DT_S));
	zassert_equal(ekf_update_accel(&ekf, level), -EAGAIN);
	zassert_equal(ekf.stats.tilt_resets, 1);

	quat_to_euler(ekf.x, &roll, &pitch, &yaw);
	zassert_within(roll, 0.0f, 1e-4f);
	zassert_within(pitch, 0.0f, 1e-4f);
	zassert_within(yaw, 25.0f * SIM_DEG, 1e-4f);
}

ZTEST(ekf_core, test_mag_update_gates)
{
	const float identity[4] = { 1.0f, 0.0f, 0.0f, 0.0f };
	const float good[3] = { sim_field_n[0], sim_field_n[1], sim_field_n[2] };
	const float strong[3] = { 1.3f * good[0], 1.3f * good[1], 1.3f * good[2] };
	const float flat[3] = { SIM_FIELD_NORM, 0.0f, 0.0f };
	float nose_up[4];

	zassert_ok(ekf_init(&ekf, &params, identity, zero_bias, true));

	zassert_equal(ekf_update_mag(&ekf, strong), -EAGAIN, "norm gate");
	zassert_equal(ekf_update_mag(&ekf, flat), -EAGAIN, "dip gate");
	zassert_equal(ekf.stats.mag_gated, 2);

	ekf_set_use_mag(&ekf, false);
	zassert_equal(ekf_update_mag(&ekf, good), -EAGAIN, "disabled");
	zassert_equal(ekf.stats.mag_gated, 3);
	zassert_false(ekf.yaw_valid);

	ekf_set_use_mag(&ekf, true);
	zassert_ok(ekf_update_mag(&ekf, good));
	zassert_true(ekf.yaw_valid);
	zassert_equal(ekf.stats.mag_rejected, 0);

	/* Above 80 degrees of pitch yaw is not defined well enough to correct. */
	quat_from_euler(0.0f, 85.0f * SIM_DEG, 0.0f, nose_up);
	zassert_ok(ekf_init(&ekf, &params, nose_up, zero_bias, true));
	zassert_equal(ekf_update_mag(&ekf, good), -EAGAIN, "singularity gate");
	zassert_equal(ekf.stats.mag_gated, 4);
}

ZTEST(ekf_core, test_init_and_align_reject_bad_arguments)
{
	const float zero_q[4] = { 0.0f, 0.0f, 0.0f, 0.0f };
	const float nan_q[4] = { NAN, 0.0f, 0.0f, 0.0f };
	const float accel[3] = { 0.0f, 0.0f, -EKF_G0 };
	const float zero_vector[3] = { 0.0f, 0.0f, 0.0f };
	struct ekf_params no_field = params;
	float q[4];

	no_field.field_norm_g = 0.0f;

	zassert_equal(ekf_init(&ekf, &params, nan_q, zero_bias, true), -EINVAL);
	zassert_equal(ekf_init(&ekf, &no_field, v1_q, zero_bias, true), -EINVAL);
	zassert_equal(ekf_init(&ekf, &params, zero_q, zero_bias, true), -EDOM);

	zassert_equal(ekf_align(zero_vector, zero_vector, false, 0.0f, q), -EINVAL);
	zassert_equal(ekf_align(accel, zero_vector, true, 0.0f, q), -EINVAL);
	zassert_ok(ekf_align(accel, zero_vector, false, 0.0f, q));
}

ZTEST_SUITE(ekf_core, NULL, NULL, reset_fixture, NULL, NULL);
```

## src/test_ekf_math.c
```c
/* TEST_PLAN.md section 3.2, T-MATH-01..10. */
#include <errno.h>
#include <math.h>

#include <zephyr/ztest.h>

#include "ekf_math.h"
#include "sim.h"

static const float v1_q[4] = { 0.8616424f, 0.2996729f, -0.0574224f, 0.4055504f };

static void assert_vec_near(const float *actual, const float *expected, int count, float tol)
{
	for (int i = 0; i < count; i++) {
		zassert_within(actual[i], expected[i], tol, "element %d", i);
	}
}

static void random_unit_quat(uint32_t *seed, float q[4])
{
	float norm;

	for (int i = 0; i < 4; i++) {
		q[i] = sim_randn(seed);
	}
	zassert_ok(quat_normalize(q, &norm));
}

ZTEST(ekf_math, test_quat_multiply_identities)
{
	const float identity[4] = { 1.0f, 0.0f, 0.0f, 0.0f };
	const float i_unit[4] = { 0.0f, 1.0f, 0.0f, 0.0f };
	const float j_unit[4] = { 0.0f, 0.0f, 1.0f, 0.0f };
	const float k_unit[4] = { 0.0f, 0.0f, 0.0f, 1.0f };
	const float v1_conj[4] = { v1_q[0], -v1_q[1], -v1_q[2], -v1_q[3] };
	float out[4];

	quat_multiply(v1_q, identity, out);
	assert_vec_near(out, v1_q, 4, 1e-6f);

	quat_multiply(i_unit, j_unit, out);
	assert_vec_near(out, k_unit, 4, 1e-6f);

	quat_multiply(v1_q, v1_conj, out);
	assert_vec_near(out, identity, 4, 1e-6f);
}

ZTEST(ekf_math, test_quat_normalize_scales_and_rejects_zero)
{
	const float identity[4] = { 1.0f, 0.0f, 0.0f, 0.0f };
	float q[4] = { 2.0f, 0.0f, 0.0f, 0.0f };
	float zero[4] = { 0.0f, 0.0f, 0.0f, 0.0f };
	float norm;

	zassert_ok(quat_normalize(q, &norm));
	assert_vec_near(q, identity, 4, 1e-6f);
	zassert_within(norm, 2.0f, 1e-6f);

	zassert_equal(quat_normalize(zero, &norm), -EDOM);
}

ZTEST(ekf_math, test_euler_to_quat_and_rotation_match_reference)
{
	const float v2_rot[3][3] = {
		{ 0.6644630f, -0.7332948f, 0.1441097f },
		{ 0.6644630f, 0.4914501f, -0.5629971f },
		{ 0.3420201f, 0.4698463f, 0.8137977f },
	};
	float q[4], rot[3][3];

	quat_from_euler(30.0f * SIM_DEG, -20.0f * SIM_DEG, 45.0f * SIM_DEG, q);
	assert_vec_near(q, v1_q, 4, 1e-5f);

	quat_to_rotation_matrix(q, rot);
	for (int row = 0; row < 3; row++) {
		assert_vec_near(rot[row], v2_rot[row], 3, 1e-5f);
	}
}

ZTEST(ekf_math, test_euler_round_trip_grid)
{
	float max_error = 0.0f;

	for (int roll = -170; roll <= 170; roll += 10) {
		for (int pitch = -80; pitch <= 80; pitch += 10) {
			for (int yaw = -170; yaw <= 170; yaw += 10) {
				const float in[3] = { (float)roll * SIM_DEG, (float)pitch * SIM_DEG,
						      (float)yaw * SIM_DEG };
				float q[4], out[3];

				quat_from_euler(in[0], in[1], in[2], q);
				quat_to_euler(q, &out[0], &out[1], &out[2]);
				for (int i = 0; i < 3; i++) {
					max_error = fmaxf(max_error, fabsf(out[i] - in[i]));
				}
			}
		}
	}

	zassert_true(max_error < 2e-4f, "max error %d urad", (int)(max_error * 1e6f));
}

ZTEST(ekf_math, test_rotation_matrix_matches_quaternion_sandwich)
{
	uint32_t seed = 0x12345678U;

	for (int trial = 0; trial < 100; trial++) {
		float q[4], rot[3][3], tmp[4], sandwich[4], rotated[3];
		float v[4] = { 0.0f, sim_randn(&seed), sim_randn(&seed), sim_randn(&seed) };

		random_unit_quat(&seed, q);
		const float q_conj[4] = { q[0], -q[1], -q[2], -q[3] };

		quat_to_rotation_matrix(q, rot);
		for (int row = 0; row < 3; row++) {
			rotated[row] = rot[row][0] * v[1] + rot[row][1] * v[2] + rot[row][2] * v[3];
		}

		quat_multiply(q, v, tmp);
		quat_multiply(tmp, q_conj, sandwich);
		assert_vec_near(rotated, &sandwich[1], 3, 1e-5f);
	}
}

ZTEST(ekf_math, test_rotation_vector_exponential)
{
	const float v7_rotvec[3] = { 0.1f * 0.01f, -0.2f * 0.01f, 0.3f * 0.01f };
	const float v7_dq[4] = { 0.9999983f, 0.0005000f, -0.0010000f, 0.0015000f };
	const float v7_product[4] = { 0.8608253f, 0.3004226f, -0.0585307f, 0.4065712f };
	const float tiny[3] = { 1e-9f, 0.0f, 0.0f };
	const float half_turn[3] = { EKF_PI, 0.0f, 0.0f };
	const float half_turn_q[4] = { 0.0f, 1.0f, 0.0f, 0.0f };
	const float below[3] = { 0.9999e-3f, 0.0f, 0.0f };
	const float above[3] = { 1.0001e-3f, 0.0f, 0.0f };
	float dq[4], product[4], dq_below[4], dq_above[4];

	quat_from_rotation_vector(v7_rotvec, dq);
	assert_vec_near(dq, v7_dq, 4, 1e-6f);
	quat_multiply(v1_q, dq, product);
	assert_vec_near(product, v7_product, 4, 1e-6f);

	quat_from_rotation_vector(tiny, dq);
	zassert_true(ekf_all_finite(dq, 4));
	zassert_within(dq[0], 1.0f, 1e-6f);

	quat_from_rotation_vector(half_turn, dq);
	assert_vec_near(dq, half_turn_q, 4, 1e-6f);

	/* The series and the closed form must meet at the switch-over angle. */
	quat_from_rotation_vector(below, dq_below);
	quat_from_rotation_vector(above, dq_above);
	zassert_within(dq_below[0], dq_above[0], 1e-7f);
	zassert_within(dq_below[1] / below[0], dq_above[1] / above[0], 1e-7f);
}

static float yaw_of(const float q[4])
{
	float roll, pitch, yaw;

	quat_to_euler(q, &roll, &pitch, &yaw);
	return yaw;
}

ZTEST(ekf_math, test_jacobians_match_reference_and_finite_differences)
{
	const float v6_gravity[3][4] = {
		{ -0.1148449f, -0.8111009f, 1.7232849f, -0.5993457f },
		{ -0.5993457f, -1.7232849f, -0.8111009f, 0.1148449f },
		{ -1.7232849f, 0.5993457f, -0.1148449f, -0.8111009f },
	};
	const float v6_heading[4] = { 0.6103431f, -0.0864193f, 0.2781614f, 2.5174362f };
	const float step = 1e-3f;
	uint32_t seed = 0x12345678U;
	float predicted[3], gravity_jac[3][4], heading_jac[4], cos2_pitch;

	ekf_gravity_direction(v1_q, predicted, gravity_jac);
	ekf_heading_jacobian(v1_q, heading_jac, &cos2_pitch);
	for (int row = 0; row < 3; row++) {
		assert_vec_near(gravity_jac[row], v6_gravity[row], 4, 1e-4f);
	}
	assert_vec_near(heading_jac, v6_heading, 4, 1e-4f);

	for (int trial = 0; trial < 50; trial++) {
		float q[4];

		random_unit_quat(&seed, q);
		ekf_gravity_direction(q, predicted, gravity_jac);
		ekf_heading_jacobian(q, heading_jac, &cos2_pitch);

		for (int col = 0; col < 4; col++) {
			float plus[4] = { q[0], q[1], q[2], q[3] };
			float minus[4] = { q[0], q[1], q[2], q[3] };
			float h_plus[3], h_minus[3], unused[3][4];

			plus[col] += step;
			minus[col] -= step;
			ekf_gravity_direction(plus, h_plus, unused);
			ekf_gravity_direction(minus, h_minus, unused);
			for (int row = 0; row < 3; row++) {
				zassert_within(gravity_jac[row][col],
					       (h_plus[row] - h_minus[row]) / (2.0f * step), 2e-3f);
			}

			/* Yaw is ill-conditioned near the poles; the filter gates there too. */
			if (cos2_pitch > 0.25f) {
				float slope = ekf_wrap_pi(yaw_of(plus) - yaw_of(minus)) / (2.0f * step);

				zassert_within(heading_jac[col], slope, 2e-3f * (1.0f + fabsf(slope)));
			}
		}
	}
}

ZTEST(ekf_math, test_omega_and_xi_identities)
{
	const float w[3] = { 0.3f, -0.7f, 1.1f };
	const float w_quat[4] = { 0.0f, w[0], w[1], w[2] };
	float omega[4][4], xi[4][3], product[4];

	quat_multiply(v1_q, w_quat, product);
	quat_omega_matrix(w, omega);
	quat_xi_matrix(v1_q, xi);

	for (int row = 0; row < 4; row++) {
		float via_omega = 0.0f, via_xi = 0.0f;

		for (int col = 0; col < 4; col++) {
			via_omega += omega[row][col] * v1_q[col];
		}
		for (int col = 0; col < 3; col++) {
			via_xi += xi[row][col] * w[col];
		}
		zassert_within(via_omega, product[row], 1e-6f);
		zassert_within(via_xi, product[row], 1e-6f);
	}

	for (int col = 0; col < 3; col++) {
		float dot = 0.0f;

		for (int row = 0; row < 4; row++) {
			dot += xi[row][col] * v1_q[row];
		}
		zassert_within(dot, 0.0f, 1e-6f);
	}
}

ZTEST(ekf_math, test_euler_at_gimbal_lock_stays_finite)
{
	for (int sign = -1; sign <= 1; sign += 2) {
		float q[4], euler[3];

		quat_from_euler(0.3f, (float)sign * 0.5f * EKF_PI, -0.4f, q);
		quat_to_euler(q, &euler[0], &euler[1], &euler[2]);

		zassert_true(ekf_all_finite(euler, 3));
		zassert_within(fabsf(euler[1]), 0.5f * EKF_PI, 1e-3f);
	}
}

ZTEST(ekf_math, test_wrap_pi_range)
{
	zassert_within(ekf_wrap_pi(EKF_PI + 0.1f), -EKF_PI + 0.1f, 1e-6f);
	zassert_within(ekf_wrap_pi(-EKF_PI), EKF_PI, 1e-6f);
	zassert_within(ekf_wrap_pi(0.5f), 0.5f, 1e-6f);
	zassert_within(ekf_wrap_pi(7.0f * EKF_PI + 0.2f), -EKF_PI + 0.2f, 1e-5f);
}

ZTEST_SUITE(ekf_math, NULL, NULL, NULL, NULL, NULL);
```
